// Distance in inches on the OLED, with Gengar and a too-close warning.
//
// WIRING
//   HC-SR04:  VCC -> VIN     Gnd -> GND     Trig -> D12    Echo -> D13
//   OLED:     VCC -> 3V3     GND -> GND     SDA  -> D21    SCL  -> D22
//
// BEHAVIOUR
//   over 20 in    ->  Gengar only, no numbers
//   20 in or less ->  the distance readout
//   under 8 in    ->  "Roman! Too Close!"
//
// Serial Monitor at 115200.

#include <Wire.h>
#include <Adafruit_GFX.h>
#include <Adafruit_SSD1306.h>

#define TRIG_PIN 12
#define ECHO_PIN 13

#define SCREEN_W   128
#define SCREEN_H   64
#define OLED_ADDR  0x3C

#define GENGAR_ABOVE_INCHES 15.0f   // above this, show Gengar instead of numbers
#define TOO_CLOSE_INCHES     8.0f   // below this, shout

#define GENGAR_W 56
#define GENGAR_H 56

Adafruit_SSD1306 display(SCREEN_W, SCREEN_H, &Wire, -1);
bool haveDisplay = false;

// 56x56 monochrome Gengar, 7 bytes per row, MSB first.
const unsigned char GENGAR[] PROGMEM = {
  0x00, 0x00, 0x00, 0x00, 0x00, 0x00, 0x00,
  0x00, 0x00, 0x00, 0x00, 0x00, 0x00, 0x00,
  0x00, 0x00, 0x00, 0x00, 0x00, 0x00, 0x00,
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  0x00, 0x00, 0x00, 0x00, 0x00, 0x00, 0x00
};
void setup() {
  Serial.begin(115200);
  delay(200);

  pinMode(TRIG_PIN, OUTPUT);
  pinMode(ECHO_PIN, INPUT);
  digitalWrite(TRIG_PIN, LOW);

  haveDisplay = display.begin(SSD1306_SWITCHCAPVCC, OLED_ADDR);
  if (!haveDisplay) {
    Serial.println("OLED not found at 0x3C - check wiring, or try 0x3D");
  } else {
    display.clearDisplay();
    display.setTextColor(SSD1306_WHITE);
    display.display();
  }
}

// One ping. Returns inches, or -1 if nothing came back.
float pingInches() {
  digitalWrite(TRIG_PIN, LOW);
  delayMicroseconds(3);
  digitalWrite(TRIG_PIN, HIGH);
  delayMicroseconds(10);
  digitalWrite(TRIG_PIN, LOW);

  long duration = pulseIn(ECHO_PIN, HIGH, 30000);
  if (duration == 0) return -1.0f;

  float inches = duration * 0.0135205f / 2.0f;
  if (inches < 1.0f || inches > 120.0f) return -1.0f;
  return inches;
}

// Median of three - one bad ping cannot outvote two good ones.
float readInches() {
  float a = pingInches(); delay(20);
  float b = pingInches(); delay(20);
  float c = pingInches();
  if (a < 0 || b < 0 || c < 0) return -1.0f;
  float hi = max(a, max(b, c));
  float lo = min(a, min(b, c));
  return a + b + c - hi - lo;
}

void loop() {
  float inches = readInches();

  if (inches < 0) Serial.println("no target");
  else { Serial.print(inches, 1); Serial.println(" in"); }

  if (haveDisplay) {
    display.clearDisplay();

    if (inches < 0 || inches > GENGAR_ABOVE_INCHES) {
      // Plenty of room (or nothing in range): just Gengar, centred.
      display.drawBitmap((SCREEN_W - GENGAR_W) / 2, (SCREEN_H - GENGAR_H) / 2,
                         GENGAR, GENGAR_W, GENGAR_H, SSD1306_WHITE);

    } else if (inches < TOO_CLOSE_INCHES) {
      display.setTextSize(2);
      display.setCursor(0, 4);
      display.print("Roman!");
      display.setCursor(0, 26);
      display.print("Too Close!");
      display.setTextSize(1);
      display.setCursor(0, 52);
      display.print(inches, 1);
      display.print(" in");

    } else {
      display.setTextSize(1);
      display.setCursor(0, 0);
      display.print("DISTANCE");
      display.setTextSize(3);
      display.setCursor(0, 20);
      display.print(inches, 1);
      display.setTextSize(2);
      display.print(" in");
    }

    display.display();
  }

  delay(100);
}
